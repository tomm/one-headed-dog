#include <Arduino.h>
#include "fabgl.h"
#include "fabglconf.h"
#include "fabutils.h"
#include "emudevs/Z80.h"
#include <string.h>

fabgl::PS2Controller PS2Controller;
fabgl::VGADirectController VGAController;
constexpr int scanlinesPerCallback = 2;
static TaskHandle_t mainTaskHandle = NULL;
#define SDCARD_MOUNT_PATH "/SD"

/** Next is the string in CAT's internal memory containing the edit line, **/
/** intialized in startup.                              **/
volatile char editLine[38];
volatile char previousEditLine[38];
volatile uint16_t bytesRead;

/** The above is self-explanatory: it allows for repeating previous command **/
volatile byte pos = 1;						/** Position in edit line currently occupied by cursor **/
volatile bool mode = false;	/** false = 6502 mode, true = Z80 mode**/
volatile bool cpurunning = false;			/** true = CPU is running, CAT should not use the buses **/
volatile bool interruptFlag = false;		/** true = Triggered by interrupt **/
volatile bool fast = true;	/** true = 8 MHz CPU clock, false = 4 MHz CPU clock **/
volatile bool expflag = false;
void(* resetFunc) (void) = 0;       		/** Software reset fuction at address 0 **/

/** Compilation defaults **/
#define	config_dev_mode	0			// Turn off various BIOS outputs to speed up development, specifically uploading code
#define config_silent 0				// Turn off the startup jingle
#define config_enable_nmi 1			// Turn on the 50hz NMI timer when CPU is running. If set to 0 will only trigger an NMI on keypress
#define config_outbox_flag 0x0200	// Outbox flag memory location (byte)
#define config_outbox_data 0x0201	// Outbox data memory location (byte)
#define config_inbox_flag 0x0202	// Inbox flag memory location (byte)
#define config_inbox_data 0x0203	// Inbox data memory location (word)
#define config_code_start 0x0205	// Start location of code
#define config_eeprom_address_mode    0 // First EEPROM location
#define config_eeprom_address_speed   1 // Second EEPROM location

/* Status constants */
#define STATUS_DEFAULT 0
#define STATUS_BOOT 1
#define STATUS_READY 2
#define STATUS_UNKNOWN_COMMAND 3
#define STATUS_NO_FILE 4
#define STATUS_CANNOT_OPEN 5  
#define STATUS_MISSING_OPERAND 6
#define STATUS_SCROLL_PROMPT 7
#define STATUS_FILE_EXISTS 8
#define STATUS_ADDRESS_ERROR 9
#define STATUS_POWER 10
#define STATUS_EOF 11

#define PS2_F12 (-fabgl::VK_F12)
#define PS2_ENTER 13
#define PS2_DELETE 8
#define PS2_UPARROW (-fabgl::VK_UP)
#define PS2_LEFTARROW (-fabgl::VK_LEFT)
#define PS2_DOWNARROW (-fabgl::VK_DOWN)

const uint8_t chardefs[] = {
    0x5a, 0x99, 0xe7, 0x5e, 0x5e, 0x24, 0x18, 0x66, 0xf0, 0xf0, 0xf0, 0xf0,
    0x00, 0x00, 0x00, 0x00, 0x0f, 0x0f, 0x0f, 0x0f, 0x00, 0x00, 0x00, 0x00,
    0xff, 0xff, 0xff, 0xff, 0x00, 0x00, 0x00, 0x00, 0x00, 0x00, 0x00, 0x00,
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    0xc3, 0xbd, 0x66, 0x5e, 0x5e, 0x66, 0xbd, 0xc3
};

const uint8_t cerbicon_img[] = {
    0x20, 0x20, 0x20, 0x20, 0x20, 0x20, 0x20, 0x20, 0x20, 0x20, 0x20, 0x20,
    0x20, 0x20, 0x20, 0x20, 0x20, 0x20, 0x20, 0x20, 0x20, 0x20, 0x20, 0x20,
    0x20, 0x20, 0x20, 0x20, 0x20, 0x20, 0x20, 0x20, 0x20, 0x20, 0x20, 0x20,
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    0x20, 0x20, 0x20, 0x20, 0x20, 0x20, 0x20, 0x20, 0x20, 0x20
};

uint8_t cerb_ram[65536];

void cpoke(uint16_t addr, uint8_t val) { cerb_ram[addr] = val; }
byte cpeek(unsigned int address) { return cerb_ram[address]; }
#define tone(a,b,c)

void cprintChar(byte x, byte y, byte token) {
  	/** First, calculate address **/
  	unsigned int address = 0xF800 + ((y - 1) * 40) + (x - 1); /** Video memory addresses start at 0XF800 **/
  	cpoke(address, token);
}

void clearLine(byte y) {
  	unsigned int x;
  	for (x = 2; x <= 39; x++) {
    	cprintChar(x, y, 32);
	}
}

void cls() {
  	/** This clears the screen only WITHIN the main frame **/
  	unsigned int y;
  	for (y = 2; y <= 25; y++) {
    	clearLine(y);
	}
}

void ccls() {
  	/** This clears the entire screen **/
  	unsigned int x;
  	for (x = 0; x < 1200; x++) {
	    cpoke(0xF800 + x, 32);        /** Video memory addresses start at 0XF800 **/
	}
}

void cprintFrames() {
  unsigned int x;
  unsigned int y;
  /** First print horizontal bars **/
  for (x = 2; x <= 39; x++) {
    cprintChar(x, 1, 3);
    cprintChar(x, 30, 131);
    cprintChar(x, 26, 3);
  }
  /** Now print vertical bars **/
  for (y = 1; y <= 30; y++) {
    cprintChar(1, y, 160);
    cprintChar(40, y, 160);
  }
}

void cprintString(byte x, byte y, String text) {
  	unsigned int i;
  	for (i = 0; i < text.length(); i++) {
	    if (((x + i) > 1) && ((x + i) < 40)) {
			cprintChar(x + i, y, text[i]);
		}
  	}
}

void center(String text) {
  	clearLine(27);
  	cprintString(2+(38-text.length())/2, 27, text);
}

void cprintStatus(byte status) {
  	/** REMEMBER: The macro "F()" simply tells the compiler to put the string in code memory, so to save dynamic memory **/
  	switch( status ) {
    	case STATUS_BOOT:
      		center(F("Here we go! Hang on..."));
      		break;
    	case STATUS_READY:
      		center(F("Alright, done!"));
      		break;
    	case STATUS_UNKNOWN_COMMAND:
      		center(F("Darn, unrecognized command"));
      		tone(SOUND, 50, 150);
      		break;
    	case STATUS_NO_FILE:
      		center(F("Oops, file doesn't seem to exist"));
      		tone(SOUND, 50, 150);
      		break;
    	case STATUS_CANNOT_OPEN:
      		center(F("Oops, couldn't open the file"));
      		tone(SOUND, 50, 150);
      		break;
    	case STATUS_MISSING_OPERAND:
      		center(F("Oops, missing an operand!!"));
      		tone(SOUND, 50, 150);
      		break;
    	case STATUS_SCROLL_PROMPT:
      		center(F("Press a key to scroll, ESC to stop"));
      		break;
    	case STATUS_FILE_EXISTS:
      		center(F("The file already exists!"));
      	break;
    		case STATUS_ADDRESS_ERROR:
      	center(F("Oops, invalid address range!"));
      		break;
    	case STATUS_POWER:
      		center(F("Feel the power of Dutch design!!"));
      		break;
    	default:
      		cprintString(2, 27, F("      CERBERUS 2100: "));
      		if (mode) cprintString(23, 27, F(" Z80, "));
      		else cprintString(23, 27, F("6502, "));
      		if (fast) cprintString(29, 27, F("8 MHz"));
      		else cprintString(29, 27, F("4 MHz"));
      		cprintString(34, 27, F("     "));
  	}
}


void errPrint(const char *msg) {
    uint16_t addr = 0xf800;

    while (*msg) {
        cpoke(addr, *msg);
        addr++;
        msg++;
    }
}

void cprintBanner() {
	/** Load the CERBERUS icon image on the screen ************/
    const uint8_t *dataFile2 = cerbicon_img;
    for (uint8_t y = 3; y <= 25; y++) {
        for (uint8_t x = 2; x <= 39; x++) {
            int inChar = *dataFile2;
            dataFile2++;
            
            cprintChar(x, y, inChar);
        }
    }
}

void cprintEditLine () {
  	byte i;
  	for (i = 0; i < 38; i++) cprintChar(i + 2, 29, editLine[i]);
}

void clearEditLine() {
  	/** Resets the contents of edit line and reprints it **/
  	byte i;
  	editLine[0] = 62;
  	editLine[1] = 0;
  	for (i = 2; i < 38; i++) editLine[i] = 32;
  	pos = 1;
  	cprintEditLine();
}

void IRAM_ATTR drawCerberusScanline(void * arg, uint8_t * dest, int scanLine)
{
    // vid ram at 0xf800 (40x30 bytes)
    // char ram at 0xf000 (2 KiB)
    auto fgcolor = VGAController.createRawPixel(RGB222(3, 3, 3));
    auto bgcolor = VGAController.createRawPixel(RGB222(0, 0, 0));

    auto width  = VGAController.getScreenWidth();
    auto height = VGAController.getScreenHeight();

    // Drawing 2 scanlines per call to drawScanline. Since cerberus
    // doubles the scanlines, we duplicate the pixel data onto the second scanline
    for (int col=0; col<40; col ++) {
        // what tile?
        uint8_t tile_num = cerb_ram[0xf800 + (scanLine / 16)*40 + col];
        // what line in the tile (0-7)
        int tile_line = (scanLine & 0xf) >> 1;
        uint8_t tile_dat = cerb_ram[0xf000 + tile_num*8 + tile_line];

        for (int p=0; p<8; p++) {
            const auto color = tile_dat & (0x80>>p) ? fgcolor : bgcolor;
            const int x = col*16 + 2*p;
            VGA_PIXELINROW(dest, x) = color;
            VGA_PIXELINROW(dest, x + 1) = color;
            VGA_PIXELINROW((dest+width), x) = color;
            VGA_PIXELINROW((dest+width), x + 1) = color;
        }
    }

    scanLine += 2;

    if (scanLine == height) {
        // signal end of screen
        vTaskNotifyGiveFromISR(mainTaskHandle, NULL);
    }
}

void load_chardefs() {
    memcpy(&cerb_ram[0xf000], chardefs, sizeof chardefs);
}

fabgl::Z80 cpu_z80;

void setup()
{
    mainTaskHandle = xTaskGetCurrentTaskHandle();

    // init cerberus ram
    memset(cerb_ram, 0, sizeof cerb_ram);
    load_chardefs();

    Serial.begin(9600);
    PS2Controller.begin(PS2Preset::KeyboardPort0_MousePort1, KbdMode::CreateVirtualKeysQueue);
    PS2Controller.keyboard()->setLayout(&fabgl::UKLayout);
    PS2Controller.keyboard()->setCodePage(fabgl::CodePages::get(1252));

    VGAController.begin();
    VGAController.setScanlinesPerCallBack(scanlinesPerCallback);
    VGAController.setDrawScanlineCallback(drawCerberusScanline);
    VGAController.setResolution(VGA_640x480_60Hz);

    ccls();
    cprintFrames();
    cprintBanner();
    cprintStatus(STATUS_BOOT);
  	//playJingle();
    delay(1000);
    cprintStatus(STATUS_DEFAULT);
    clearEditLine();

    if (!FileBrowser::mountSDCard(false, SDCARD_MOUNT_PATH)) {
        errPrint("Failed to mount SDCard");
    }
}

int readKey() {
    auto keyboard = PS2Controller.keyboard();
    // maybe read from debug serial
    if (keyboard) {
        if (keyboard->virtualKeyAvailable()) {
            fabgl::VirtualKeyItem key;
            bool success = keyboard->getNextVirtualKey(&key, 0);
            if (success && key.down) {
                if (key.ASCII) {
                    return key.ASCII;
                } else {
                    return -key.vk;
                }
            }
        }
    }
    return 0;
}

String getNextWord(bool fromTheBeginning) {
  /** A very simple parser that returns the next word in the edit line **/
  static byte initialPosition;    /** Start parsing from this point in the edit line **/
  byte i, j, k;                   /** General-purpose indices **/
  if (fromTheBeginning) initialPosition = 1; /** Starting from the beginning of the edit line **/
  i = initialPosition;            /** Otherwise, continuing on from where we left off in previous call **/
  while ((editLine[i] == 32) || (editLine[i] == 44)) i++; /** Ignore leading spaces or commas **/
  j = i + 1;                      /** Now start indexing the next word proper **/
  /** Find the end of the word, marked either by a space, a comma or the cursor **/
  while ((editLine[j] != 32) && (editLine[j] != 44) && (editLine[j] != 0)) j++;
  char nextWord[j - i + 1];       /** Create a buffer (the +1 is to make space for null-termination) **/
  for (k = i; k < j; k++) nextWord[k - i] = editLine[k]; /** Transfer the word to the buffer **/
  nextWord[j - i] = 0;            /** Null-termination **/
  initialPosition = j;            /** Next time round, start from here, unless... **/
  return (nextWord);              /** Return the contents of the buffer **/
}

void list(String address) {
  /** Lists the contents of memory from the given address, in a compact format **/
  byte i, j;                      /** Just counters **/
  unsigned int addr;              /** Memory address **/
  if (address == "") addr = 0;
  else addr = strtol(address.c_str(), NULL, 16); /** Convert hexadecimal address string to unsigned int **/
  for (i = 2; i < 25; i++) {
    cprintString(3, i, "0x");
    cprintString(5, i, String(addr, HEX));
    for (j = 0; j < 8; j++) {
      cprintString(12+(j*3), i, String(cpeek(addr++), HEX)); /** Print bytes in HEX **/
    }
  }
}

unsigned int addressTranslate (unsigned int virtualAddress) {
  	byte numberVirtualRows;
  	numberVirtualRows = (virtualAddress - 0xF800) / 38;
  	return((virtualAddress + 43) + (2 * (numberVirtualRows - 1)));
}

void testMem() {
  	/** Tests that all four memories are accessible for reading and writing **/
  	unsigned int x;
  	byte i = 0;
    for (x = 0; x < 874; x++) {
    	cpoke(x, i);                                           /** Write to low memory **/
    	cpoke(0x8000 + x, cpeek(x));                           /** Read from low memory and write to high memory **/
    	cpoke(addressTranslate(0xF800 + x), cpeek(0x8000 + x));/** Read from high mem, write to VMEM, read from character mem **/
    	if (i < 255) i++;
    	else i = 0;
  	}
}

void storePreviousLine() {
	for (byte i = 0; i < 38; i++) previousEditLine[i] = editLine[i]; /** Store edit line just executed **/
}

void help() {
  cls();
  cprintString(3, 2,  F("The Byte Attic's CERBERUS 2100 (tm)"));
  cprintString(3, 3,  F("        AVAILABLE COMMANDS:"));
  cprintString(3, 4,  F(" (All numbers must be hexadecimal)"));
  cprintString(3, 6,  F("0xADDR BYTE: Writes BYTE at ADDR"));
  cprintString(3, 7,  F("list ADDR: Lists memory from ADDR"));
  cprintString(3, 8,  F("cls: Clears the screen"));
  cprintString(3, 9,  F("testmem: Reads/writes to memories"));
  cprintString(3, 10, F("6502: Switches to 6502 CPU mode"));
  cprintString(3, 11, F("z80: Switches to Z80 CPU mode"));
  cprintString(3, 12, F("fast: Switches to 8MHz mode"));
  cprintString(3, 13, F("slow: Switches to 4MHz mode"));
  cprintString(3, 14, F("reset: Resets the system"));
  cprintString(3, 15, F("dir: Lists files on uSD card"));
  cprintString(3, 16, F("del FILE: Deletes FILE"));
  cprintString(3, 17, F("load FILE ADDR: Loads FILE at ADDR"));
  cprintString(3, 18, F("save ADDR1 ADDR2 FILE: Saves memory"));
  cprintString(5, 19, F("from ADDR1 to ADDR2 to FILE"));
  cprintString(3, 20, F("run: Executes code in memory"));
  cprintString(3, 21, F("move ADDR1 ADDR2 ADDR3: Moves bytes"));
  cprintString(5, 22, F("between ADDR1 & ADDR2 to ADDR3 on"));
  cprintString(3, 23, F("help / ?: Shows this help screen"));
  cprintString(3, 24, F("F12 key: Quits CPU program"));
}

FILE *SD_open(String &filename) {
	static char name[256];
    snprintf(name, sizeof name, "%s/%s", SDCARD_MOUNT_PATH, filename.c_str());

    return fopen(name, "rb");
}

int load(String filename, unsigned int startAddr) {
  /** Loads a binary file from the uSD card into memory **/
  FILE *dataFile;                                /** File for reading from on SD Card, if present **/
  uint16_t addr = startAddr;                /** Address where to load the file into memory **/
  int status = STATUS_DEFAULT;
  if (filename == "") {
	  status = STATUS_MISSING_OPERAND;
  }
  else {
#if 0
    if (!SD.exists(filename)) {
		status = STATUS_NO_FILE;				/** The file does not exist, so stop with error **/
	} 
    else {
#endif /* 0 */
      	dataFile = SD_open(filename);           /** Open the binary file **/
      	if (!dataFile) {
			status = STATUS_CANNOT_OPEN; 		/** Cannot open the file **/
	  	}
      	else {
			bytesRead = 0;
            int dataByte;
            while ((dataByte = fgetc(dataFile)) != EOF) {
          	bytesRead++;
          	cpoke(addr++, dataByte);
          	if (addr == 0) {                    /** Break if address wraps around to the start of memory **/
                fclose(dataFile);
            	break;
          	}
        }
        fclose(dataFile);
		status = STATUS_READY;
      }
    //}
  }
  return status;
}

void catLoad(String filename, String startAddress, bool silent) {
	unsigned int startAddr;
	int status = STATUS_DEFAULT;
	if (startAddress == "") {
		startAddr = config_code_start;	/** If not otherwise specified, load file into start of code area **/
	}
	else {
		startAddr = strtol(startAddress.c_str(), NULL, 16);	/** Convert address string to hexadecimal number **/
	}
	status = load(filename, startAddr);
	if(!silent) {
		cprintStatus(status);
	}
}

/************************************************************************************************/
void enter() {  /** Called when the user presses ENTER, unless a CPU program is being executed **/
/************************************************************************************************/
  unsigned int addr;                /** Memory addresses **/
  byte data;                        /** A byte to be stored in memory **/
  byte i;                           /** Just a counter **/
  String nextWord, nextNextWord, nextNextNextWord; /** General-purpose strings **/
  nextWord = getNextWord(true);     /** Get the first word in the edit line **/
  nextWord.toLowerCase();           /** Ignore capitals **/
  if( nextWord.length() == 0 ) {    /** Ignore empty line **/
    //Serial.println(F("OK"));
    return;
  }
  /** MANUAL ENTRY OF OPCODES AND DATA INTO MEMORY *******************************************/
  if ((nextWord.charAt(0) == '0') && (nextWord.charAt(1) == 'x')) { /** The user is entering data into memory **/
    nextWord.remove(0,2);                       /** Removes the "0x" at the beginning of the string to keep only a HEX number **/
    addr = strtol(nextWord.c_str(), NULL, 16);  /** Converts to HEX number type **/
    nextNextWord = getNextWord(false);          /** Get next byte **/
    byte chkA = 1;
    byte chkB = 0;
    while (nextNextWord != "") {                /** For as long as user has typed in a byte, store it **/
      if(nextNextWord.charAt(0) != '#') {
        data = strtol(nextNextWord.c_str(), NULL, 16);/** Converts to HEX number type **/
        while( cpeek(addr) != data ) {          /** Serial comms may cause writes to be missed?? **/
          cpoke(addr, data);
        }
        chkA += data;
        chkB += chkA;
        addr++;
      }
      else {
        nextNextWord.remove(0,1);
        addr = strtol(nextNextWord.c_str(), NULL, 16);
        if( addr != ((chkA << 8) | chkB) ) {
          cprintString(28, 26, nextWord);
          tone(SOUND, 50, 50);
        }
      }
      nextNextWord = getNextWord(false);  /** Get next byte **/
    }
    #if config_dev_mode == 0
    cprintStatus(STATUS_READY);
    cprintString(28, 27, nextWord);
    #endif
#if 0
    Serial.print(nextWord);
    Serial.print(' ');
    Serial.println((uint16_t)((chkA << 8) | chkB), HEX);
#endif /* 0 */
    
  /** LIST ***********************************************************************************/
  } else if (nextWord == F("list")) {     /** Lists contents of memory in compact format **/
    cls();
    nextWord = getNextWord(false);        /** Get address **/
    list(nextWord);
    cprintStatus(STATUS_READY);
  /** CLS ************************************************************************************/
  } else if (nextWord == F("cls")) {      /** Clear the main window **/
    cls();
    cprintStatus(STATUS_READY);
  /** TESTMEM ********************************************************************************/
  } else if (nextWord == F("testmem")) {  /** Checks whether all four memories can be written to and read from **/
    cls();
    testMem();
    cprintStatus(STATUS_READY);
  /** 6502 ***********************************************************************************/
  } else if (nextWord == F("6502")) {     /** Switches to 6502 mode **/
    mode = false;
    //EEPROM.write(config_eeprom_address_mode,0);
    //digitalWrite(CPUSLC, LOW);            /** Tell CAT of the new mode **/
    cprintStatus(STATUS_READY);
  /** Z80 ***********************************************************************************/
  } else if (nextWord == F("z80")) {      /** Switches to Z80 mode **/
    mode = true;
    //EEPROM.write(config_eeprom_address_mode,1);
    //digitalWrite(CPUSLC, HIGH);           /** Tell CAT of the new mode **/
    cprintStatus(STATUS_READY);
  /** RESET *********************************************************************************/
  } else if (nextWord == F("reset")) {
    //pinMode(SOUND, INPUT);  /** Avoids annoying beep upon software reset **/
    resetFunc();						  /** This resets CAT and, therefore, the CPUs too **/
  /** FAST **********************************************************************************/
  } else if (nextWord == F("fast")) {     /** Sets CPU clock at 8 MHz **/
    //digitalWrite(CPUSPD, HIGH);
    fast = true;
    //EEPROM.write(config_eeprom_address_speed,1);
    cprintStatus(STATUS_READY);
  /** SLOW **********************************************************************************/
  } else if (nextWord == F("slow")) {     /** Sets CPU clock at 4 MHz **/
    //digitalWrite(CPUSPD, LOW);
    fast = false;
    //EEPROM.write(config_eeprom_address_speed,0);
    cprintStatus(STATUS_READY);
  /** DIR ***********************************************************************************/
  } else if (nextWord == F("dir")) {      /** Lists files on uSD card **/
    //dir();
  /** DEL ***********************************************************************************/
  } else if (nextWord == F("del")) {      /** Deletes a file on uSD card **/
    nextWord = getNextWord(false);
    //catDelFile(nextWord);
  /** LOAD **********************************************************************************/
  } else if (nextWord == F("load")) {     /** Loads a binary file into memory, at specified location **/
    nextWord = getNextWord(false);        /** Get the file name from the edit line **/
    nextNextWord = getNextWord(false);    /** Get memory address **/
    catLoad(nextWord, nextNextWord, false);
  /** RUN ***********************************************************************************/
  } else if (nextWord == F("run")) {      /** Runs the code in memory **/
    for (i = 0; i < 38; i++) previousEditLine[i] = editLine[i]; /** Store edit line just executed **/
    //runCode();
  /** SAVE **********************************************************************************/
  } else if (nextWord == F("basic6502")) {
    mode = false;
    //digitalWrite(CPUSLC, LOW);
    catLoad("basic65.bin","", false); 
    //runCode();
  } else if (nextWord == F("basicz80")) {
    mode = true;
    //digitalWrite(CPUSLC, HIGH);
    catLoad("basicz80.bin","", false); 
    //runCode();
#if 0
  } else if (nextWord == F("save")) {
    nextWord = getNextWord(false);						/** Start start address **/
    nextNextWord = getNextWord(false);					/** End address **/
    nextNextNextWord = getNextWord(false);				/** Filename **/
    catSave(nextNextNextWord, nextWord, nextNextWord);
  /** MOVE **********************************************************************************/
  } else if (nextWord == F("move")) {
    nextWord = getNextWord(false);
    nextNextWord = getNextWord(false);
    nextNextNextWord = getNextWord(false);
    binMove(nextWord, nextNextWord, nextNextNextWord);
  /** HELP **********************************************************************************/
#endif /* 0 */
  } else if ((nextWord == F("help")) || (nextWord == F("?"))) {
    help();
    cprintStatus(STATUS_POWER);
  /** ALL OTHER CASES ***********************************************************************/
  } else cprintStatus(STATUS_UNKNOWN_COMMAND);
  if (!cpurunning) {
    storePreviousLine();
    clearEditLine();                   /** Reset edit line **/
  }
}

void loop()
{
    // wait vblank
    //ulTaskNotifyTake(pdTRUE, portMAX_DELAY);
	int ascii = readKey();	/** Stores ascii value of key pressed **/
	byte i;     			/** Just a counter **/

  	/** Wait for a key to be pressed, then take it from there... **/
	if(ascii != 0) {
    	if(cpurunning) {
    		if (ascii == PS2_F12) {  /** This happens if F1 has been pressed... and so on... **/
	    		//stopCode();
    		}
    		else {
				cpurunning = false;						/** Just stops interrupts from happening **/
        		//digitalWrite(CPUGO, LOW);   			/** Pause the CPU and tristate its buses to high-Z **/
      			byte mode = cpeek(config_outbox_flag);
      			cpoke(config_outbox_data, ascii);       /** Put token code of pressed key in the CPU's mailbox, at config_outbox_data **/
	         	cpoke(config_outbox_flag, 0x01);		/** Flag that there is new mail for the CPU waiting at the mailbox **/
      			//digitalWrite(CPUGO, HIGH);  			/** Let the CPU go **/
				cpurunning = true;
      			#if config_enable_nmi == 0
      			//digitalWrite(CPUIRQ, HIGH); /** Trigger an interrupt **/
      			//digitalWrite(CPUIRQ, LOW);
      			#endif
    		}
    	}
    	else {
	 	   switch(ascii) {
	    		case PS2_ENTER:
		    		enter();
	    			break;
	    		case PS2_UPARROW:
		     	   	for (i = 0; i < 38; i++) editLine[i] = previousEditLine[i];
	        		i = 0;
        			while (editLine[i] != 0) i++;
        			pos = i;
        			cprintEditLine();
        			break;
        		case PS2_DOWNARROW:
		        	clearEditLine();
        			break;
        		case PS2_DELETE:
        		case PS2_LEFTARROW:
			        editLine[pos] = 32; /** Put an empty space in current cursor position **/
        			if (pos > 1) pos--; /** Update cursor position, unless reached left-most position already **/
        			editLine[pos] = 0;  /** Put cursor on updated position **/
        			cprintEditLine();   /** Print the updated edit line **/
        			break;
        		default:
		        	editLine[pos] = ascii;  /** Put new character in current cursor position **/
        			if (pos < 37) pos++;    /** Update cursor position **/
        			editLine[pos] = 0;      /** Place cursor to the right of new character **/
    				#if config_dev_mode == 0        	
		       		cprintEditLine();       /** Print the updated edit line **/
	       			#endif
        			break;        
			}
		}    
	}
	if(interruptFlag) {						/** If the interrupt flag is set then **/
		interruptFlag = false;
#if 0
		messageHandler();					/** Run the inbox message handler **/
#endif /* 0 */
	}
#if 0
	// Now we deal with bus access requests from the expansion card
  if (digitalRead(XBUSREQ) == LOW) { // The expansion card is requesting bus access... 
    if (cpurunning) { // If a CPU is running (the internal buses being therefore not tristated)...
      digitalWrite(CPUGO, LOW); // ...first pause the CPU and tristate the buses...
      digitalWrite(XBUSACK, LOW); // ...then acknowledge request; buses are now under the control of the expansion card
      while (digitalRead(XBUSREQ) == LOW); // Wait until the expansion card is done...
      digitalWrite(XBUSACK, HIGH); // ...then let the expansion card know that the buses are no longer available to it
      digitalWrite(CPUGO, HIGH); // Finally, let the CPU run again
    } else { // If a CPU is NOT running...
      digitalWrite(XBUSACK, LOW); // Acknowledge request; buses are now under the control of the expansion card
      while (digitalRead(XBUSREQ) == LOW); // Wait until the expansion card is done...
      digitalWrite(XBUSACK, HIGH); // ...then let the expansion card know that the buses are no longer available to it
    }
  }
  // And finally, deal with the expansion flag (which will be 'true' if there has been an XIRQ strobe from an expansion card)
  if (expflag) {
    if (cpurunning) {
      digitalWrite(CPUGO, LOW); // Pause the CPU and tristate its buses **/
      cpoke(0xEFFF, 0x01); // Flag that there is data from the expansion card waiting for the CPU in memory
      digitalWrite(CPUGO, HIGH); // Let the CPU go
      digitalWrite(CPUIRQ, HIGH); // Trigger an interrupt so the CPU knows there's data waiting for it in memory
      digitalWrite(CPUIRQ, LOW);
    }
    expflag = false; // Reset the flag
  }
#endif /* 0 */
}
